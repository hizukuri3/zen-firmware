#include "zen.dtsi"
#include <input/processors.dtsi>
#include <dt-bindings/zmk/input_transform.h>

/* Do not raise the pointer layer right after a keystroke. Without this, brushing
 * the trackball while typing turns J/K/L into mouse buttons on layer 1.
 *
 * excluded-positions lists the keys layer 1 actually binds, so pressing any other
 * key drops the layer immediately instead of waiting out the timeout. Without this
 * property the driver skips position handling entirely and the layer stays up for
 * the full 500ms no matter what is typed. */
&zip_temp_layer {
    require-prior-idle-ms = <150>;
    excluded-positions = <7 8 9 18 19 20 21 22 32>;
};

&pointing_listener {
    input-processors =
        <&zip_xy_transform (INPUT_TRANSFORM_X_INVERT | INPUT_TRANSFORM_Y_INVERT)>,
        <&zip_temp_layer 1 500>;

    scroller {
        layers = <4>;
        input-processors =
            <&zip_xy_transform (INPUT_TRANSFORM_Y_INVERT)>,
            <&zip_xy_to_scroll_mapper>,
            <&scroll_scaler 1 28>;
        process-next;
    };
};

&zen_transform {
    col-offset = <7>;
};
